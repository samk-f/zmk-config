## Kconfig
```kconfig
config ZMK_BEHAVIOR_KEEPALIVE
    bool
    default y
    depends on DT_HAS_ZMK_BEHAVIOR_KEEPALIVE_ENABLED
    depends on !ZMK_SPLIT || ZMK_SPLIT_ROLE_CENTRAL
```

## dts/bindings/behaviors/zmk,behavior-keepalive.yaml
```yaml
description: Periodically taps a key; param 1 = on, 0 = off
compatible: "zmk,behavior-keepalive"
include: one_param.yaml
properties:
  keycode:
    type: int
    required: true
  interval-ms:
    type: int
    default: 60000
```
